## Documentation/devicetree/bindings/clock/nexell,pll.txt
```
Binding for Nexell PLL(2555, 2651) controllers

Required Properties:
- compatible: should be one of the following.
 - "nexell,pll2555"		: PLL2555
 - "nexell,pll2651"		: PLL2651
- reg: Base address and size of the PLL memory area
- clocks: phandle of the external reference clock
- #clock-cells: should be 1.

Optional properties:
- clock-output-names: can be "pll0", "pll1", "pll_cpu", "pll_ddr0", "pll_ddr1"

Example:
	pll_0: pll0 {
		compatible = "nexell,pll2555", "syscon";
		reg = <0x27020000 0x60>;

		#clock-cells = <1>;
		clocks = <&oscclk>;
		clock-output-names = "pll0";
	};

	pll_1: pll1 {
		compatible = "nexell,pll2651", "syscon";
		reg = <0x27030000 0x60>;

		#clock-cells = <1>;
		clocks = <&oscclk>;
		clock-output-names = "pll1";
	};

	pll_cpu: pll-cpu {
		compatible = "nexell,pll2555", "syscon";
		reg = <0x22070000 0x60>;

		#clock-cells = <1>;
		clocks = <&oscclk>;
		clock-output-names = "pll_cpu";
	};

	pll_ddr0: pll-ddr0 {
		compatible = "nexell,pl2555", "syscon";
		reg = <0x23070000 0x60>;

		#clock-cells = <1>;
		clocks = <&oscclk>;
		clock-output-names = "pll_ddr0";
	};

	pll_ddr1: pll-ddr1 {
		compatible = "nexell,pll2651", "syscon";
		reg = <0x23070000 0x60>;

		#clock-cells = <1>;
		clocks = <&oscclk>;
		clock-output-names = "pll_ddr1";
	};
```

## Documentation/devicetree/bindings/input/touchscreen/nexell_tsc.txt
```
* Nexell ADC280A-TSC Touch Controller

Required properties:
- compatible: must be "nexell,adc-tsc".
- reg: adc-touch controller address and the ADC address.
- interrupts: the interrupt of this touch controller and ADC.
- clocks: the root clock of touch controller and ADC.
- clock-names; must be "tsc" and "adc".

Example:
	adc_ts: adc-ts@20600000 {
		compatible = "nexell,adc-tsc";
		reg = <0x20600000 0x1000>;
		interrupts = <GIC_SPI 0 IRQ_TYPE_NONE>;
		clocks = <&cmu CLK_ADC0_APB>;
		clock-names = "adc-ts";
		status = "okay";
	};
```

## Documentation/devicetree/bindings/media/nexell-vpu.txt
```
Device-Tree bindings for Nexell's VPU driver

Required properties:
 - compatible: value should be "nexell, nx-vpu"
 - reg: Physical base address of the IP registers and length of memory mapped
        region.
 - interrupts: The interrupt signals from the vpu.
 - clocks: Must contain an entry for each entry in clock-names.
 - clock-names: Must include the following entries.
 - memory-region: from reserved memory binding: require one memory region.

Example:
vpu: vpu@25180000 {
	compatible = "nexell, nx-vpu";
	reg = <0x25180000 0x10000>;
	interrupts = <GIC_SPI 31 IRQ_TYPE_NONE>;
	clocks = <&cmu_mm CLK_MM_CODA960_AXI>,
		<&cmu_mm CLK_MM_CODA960_APB>,
		<&cmu_mm CLK_MM_CODA960_CORE>;
	clock-names = "vpu-clk-axi", "vpu-clk-apb", "vpu-clk-core";
	assigned-clocks = <&cmu_mm CLK_MM_CODA960_CORE>;
	assigned-clock-rates = <250000000>;
	status = "disabled";
};

reserved-memory {
	#address-cells = <1>;
	#size-cells = <1>;
	ranges;

	vpu_cma: region_vpu_cma {
		compatible = "shared-dma-pool";
		reusable;
		size = <0x8000000>;
		/* linux,cma-default; */
	};
};

&vpu {
	memory-region = <&vpu_cma>;
	status = "okay";
};
```

## Documentation/devicetree/bindings/nvmem/nexell,nxp3220-efuse.txt
```
Nexell nxp3220 EFUSE Controller
==============================

The nxp3220 secure EFUSE provides secure ecid, boot key, boot hash ...
User can read by nvmem interface and function call.

Required properties:
- compatible : "nexell,nxp3220-efuse"
- reg : Offset and length of the register set for the controller device.
- cell-name : efuse cell name for the nvmem inferface
- cell-id : efuse cell id for the nvmem sys inferface

Sys interface: /sys/bus/nvmem/devices/[cell-name][cell-id]
	- /sys/bus/nvmem/devices/secid0
	- /sys/bus/nvmem/devices/sboot_key0
	.....

Example:

#define S_EFUSE_NODE_DATA(_reg, _size, _name, _id) \
		compatible = "nexell,nxp3220-efuse"; \
		reg = <_reg _size>; \
		cell-name = _name; \
		cell-id = <_id>; \
		cell-secure;

/{
		sefuse_secid: efuse@20070100 { /* 128 bits */
			S_EFUSE_NODE_DATA(0x20070100, 0x10, "secid", 0)
		};

		sefuse_bootkey0: efuse@20070110 { /* 128 bits */
			S_EFUSE_NODE_DATA(0x20070110, 0x10, "sboot_key", 0)
		};
		.....
}
```

## Documentation/devicetree/bindings/nvmem/nexell-efuse.txt
```
Nexell EFUSE Controller
==============================

The EFUSE provides secure ecid, boot key, boot hash ...
User can read by nvmem interface and function call.

Required properties:
- compatible : "nexell,secure-regmap" for a multi-function device 
	       "nexell,nxp3220-efuse" for efuse devices.
- reg : Offset and length of the register set for the controller device.
- cell-name : efuse cell name for the nvmem inferface
- cell-id : efuse cell id for the nvmem sys inferface

Sys interface: /sys/bus/nvmem/devices/[cell-name][cell-id]
	- /sys/bus/nvmem/devices/secid0
	- /sys/bus/nvmem/devices/sboot_key0
	.....

Example:

/{
	sys_sefuse: sys-sefuse@20070000 {
		compatible = "nexell,secure-regmap";

		sefuse_secid: efuse@20070100 { /* 128 bits */
			compatible = "nexell,nxp3220-efuse";
			reg = <0x100 0x10>;
			cell-name = secid;
			cell-id = 0;
		};

		sefuse_bootkey0: efuse@20070110 { /* 128 bits */
			compatible = "nexell,nxp3220-efuse";
			reg = <0x110 0x10>;
			cell-name = sboot_key;
			cell-id = 0;
		};
		.....
	};
}
```

## Documentation/devicetree/bindings/soc/nexell/nexell,nxp3220-ecid.txt
```
Nexell nxp3220 ECID Controller
==============================

The nxp3220 ECID Controller provides ecid, guid, chipname.
User can read by /sys interface and function call.

Required properties:
- compatible : "nexell,nxp3220-ecid"
- reg : Offset and length of the register set for the controller device.
- syscon: Phandle to syscon block which provide access to core hpm.
- clocks : from common clock binding: handle to cpu and core hpm clocks.
- clock-names : from common clock binding: Shall be "cpu_hpm" and "core_hpm".

Example:
ecid@20060000 {
	compatible = "nexell,nxp3220-ecid";
	reg = <0x20060000 0x1000>;
	syscon_sys = <&sys_reg_sys>;
	clocks = <&cmu_cpu CLK_CPU_HPM>, <&cmu CLK_HPM_SYS0>;
	clock-names = "cpu_hpm", "core_hpm";
};
```

## Documentation/devicetree/bindings/spi/spi-dw-nexell.txt
```
Synopsys DesignWare AMBA 2.0 Synchronous Serial Interface for NXP3220.

Required properties:
- compatible : "nexell,nxp3220-dw-spi"
- reg : The register base for the controller.
- interrupts : One interrupt, used by the controller.
- clcoks : Must contain one entry, for the module clock.
- spi-mode : Sets whether SPI operates in normal, dual, quad,
	     and octal modes.
	     Normal : 0x0,
	     Dual   : 0x1,
	     Quad   : 0x2,
	     Octal  : 0x3
- pinctrl-names : Uses "default", can use "sleep" if provided
                   See ../pinctrl/pinctrl-binding.txt
- pinctrl-0 : pin control group to be used for this controller.

Optional properties:
- cs-gpios : Specifies the gpio pis to be used for chipselects.
- dmas : DMA specifier, consisting of a phandle to DMA controller node
- dma-names : Names for the dma channels
- num-cs : The number of chipselects. If omitted, this will default to 4.
- reg-io-width : The I/O register width (in bytes) implemented by this
  device.  Supported values are 2 or 4 (the default).
- resets : phandle of the internal reset line
- slave-sel-offset : Register offset to configure slave mode
- spi-slave : make spi to slave mode
- spi-dma: Set to run dma mode if transfer size is bigger than fifo length.
- syscon : a pointer to the syscon node so we can access the syscon registers
          to set the slave mode.
- status : Set node status. disabled or okay

Child nodes as per the generic SPI binding.

Example:
in dtsi file
	spi0: spi@30000000 {
		compatible = "nexell,nxp3220-dw-spi";
		reg = <0x30000000 0x1000>;
		interrupts = <GIC_SPI 93 4>;
		clocks = <&cmu CLK_SPI0_CORE>
			<&cmu CLK_SPI0_APB>;
		clock-names = "core", "apb";
		num-cs = <1>;
		spi-mode = <0>;
		pinctrl-names = "default";
		pinctrl-0 = <&spi0_bus>;
		status = "disabled";
	};
```

## Documentation/devicetree/bindings/timer/nexell,nxp3220-timer.txt
```
Nexell NXP3220 Timer Controller

Required properties:

- compatible : should be "nexell,nxp3220-timer"
- reg : Specifies base physical address and size of the registers.
- interrupts : The interrupt of the first timer
- clocks: phandle to the source clock
- clock-names : must include the following entries:
	clock-names : "timerN"(N= 0,1, n).
- clksource : tiemr channel to uset source clock.
- clkevent : usetiemr channel to uset source clock.

Example:
	timer@208c0000 {
		compatible = "nexell,nxp3220-timer";
		reg = <0x208c0000 0x1000>;
		clocks =  <&cmu CLK_TIMER0_TCLK0>,
		       <&cmu CLK_TIMER0_TCLK1>;
		clock-names = "timer0", "timer1";
		interrupt = <0 106 0>;
		clksource = <0>;
		clkevent = <1>;
	};
```

## arch/arm/configs/artik310s_trike_defconfig
```kconfig
CONFIG_DEFAULT_HOSTNAME="artik310s"
CONFIG_SYSVIPC=y
CONFIG_POSIX_MQUEUE=y
CONFIG_USELIB=y
CONFIG_AUDIT=y
CONFIG_NO_HZ=y
CONFIG_HIGH_RES_TIMERS=y
CONFIG_BSD_PROCESS_ACCT=y
CONFIG_BSD_PROCESS_ACCT_V3=y
CONFIG_IKCONFIG=y
CONFIG_IKCONFIG_PROC=y
CONFIG_MEMCG=y
CONFIG_BLK_CGROUP=y
CONFIG_CFS_BANDWIDTH=y
CONFIG_CGROUP_PIDS=y
CONFIG_CGROUP_RDMA=y
CONFIG_CGROUP_FREEZER=y
CONFIG_CPUSETS=y
CONFIG_CGROUP_DEVICE=y
CONFIG_CGROUP_CPUACCT=y
CONFIG_NAMESPACES=y
CONFIG_USER_NS=y
CONFIG_SCHED_AUTOGROUP=y
CONFIG_BLK_DEV_INITRD=y
CONFIG_BPF_SYSCALL=y
CONFIG_EMBEDDED=y
# CONFIG_SLUB_CPU_PARTIAL is not set
CONFIG_PROFILING=y
# CONFIG_STRICT_MODULE_RWX is not set
CONFIG_MODULES=y
CONFIG_MODULE_FORCE_LOAD=y
CONFIG_MODULE_UNLOAD=y
CONFIG_MODULE_FORCE_UNLOAD=y
CONFIG_BLK_DEV_THROTTLING=y
CONFIG_PARTITION_ADVANCED=y
CONFIG_CMDLINE_PARTITION=y
CONFIG_CFQ_GROUP_IOSCHED=y
CONFIG_ARCH_NEXELL=y
CONFIG_ARCH_SIP_S31NX=y
# CONFIG_CACHE_L2X0 is not set
# CONFIG_ARM_ERRATA_643719 is not set
CONFIG_SMP=y
CONFIG_SCHED_MC=y
CONFIG_SCHED_SMT=y
CONFIG_NR_CPUS=2
CONFIG_ARM_PSCI=y
CONFIG_PREEMPT=y
CONFIG_HIGHMEM=y
# CONFIG_CPU_SW_DOMAIN_PAN is not set
CONFIG_CMA=y
CONFIG_ZPOOL=y
CONFIG_ZBUD=y
CONFIG_ZSMALLOC=y
CONFIG_PGTABLE_MAPPING=y
CONFIG_SECCOMP=y
CONFIG_ZBOOT_ROM_TEXT=0x0
CONFIG_ZBOOT_ROM_BSS=0x0
CONFIG_CPU_FREQ=y
CONFIG_CPU_FREQ_STAT=y
CONFIG_CPU_FREQ_DEFAULT_GOV_ONDEMAND=y
CONFIG_CPU_FREQ_GOV_POWERSAVE=y
CONFIG_CPU_FREQ_GOV_USERSPACE=y
CONFIG_CPU_FREQ_GOV_CONSERVATIVE=y
CONFIG_CPU_FREQ_GOV_SCHEDUTIL=y
CONFIG_CPUFREQ_DT=y
CONFIG_CPU_IDLE=y
CONFIG_CPU_IDLE_GOV_LADDER=y
CONFIG_VFP=y
CONFIG_NEON=y
CONFIG_KERNEL_MODE_NEON=y
CONFIG_BINFMT_MISC=y
CONFIG_PM_AUTOSLEEP=y
CONFIG_PM_WAKELOCKS=y
CONFIG_PM_DEBUG=y
CONFIG_NET=y
CONFIG_PACKET=y
CONFIG_UNIX=y
CONFIG_NET_KEY=y
CONFIG_INET=y
CONFIG_IP_MULTICAST=y
CONFIG_IP_PNP=y
CONFIG_IP_PNP_DHCP=y
CONFIG_IP_PNP_BOOTP=y
CONFIG_IP_PNP_RARP=y
CONFIG_DNS_RESOLVER=y
CONFIG_CFG80211=y
CONFIG_MAC80211=y
CONFIG_UEVENT_HELPER_PATH="/sbin/hotplug"
CONFIG_DEVTMPFS=y
CONFIG_DEVTMPFS_MOUNT=y
CONFIG_DMA_CMA=y
CONFIG_CMA_SIZE_MBYTES=128
CONFIG_OF_OVERLAY=y
CONFIG_BLK_DEV_LOOP=y
CONFIG_BLK_DEV_CRYPTOLOOP=y
CONFIG_BLK_DEV_RAM=y
CONFIG_BLK_DEV_RAM_SIZE=16384
CONFIG_SCSI=y
CONFIG_BLK_DEV_SD=y
CONFIG_CHR_DEV_SG=y
CONFIG_INPUT_EVDEV=y
# CONFIG_INPUT_KEYBOARD is not set
# CONFIG_INPUT_MOUSE is not set
CONFIG_VT_HW_CONSOLE_BINDING=y
# CONFIG_LEGACY_PTYS is not set
CONFIG_SERIAL_NONSTANDARD=y
CONFIG_DEVKMEM=y
CONFIG_SERIAL_8250=y
CONFIG_SERIAL_8250_DW=y
CONFIG_SERIAL_OF_PLATFORM=y
# CONFIG_HW_RANDOM is not set
CONFIG_I2C=y
CONFIG_I2C_CHARDEV=y
CONFIG_I2C_MUX=y
CONFIG_I2C_GPIO=y
CONFIG_SPI=y
CONFIG_SPI_SPIDEV=y
CONFIG_GPIOLIB=y
CONFIG_GPIO_SYSFS=y
# CONFIG_HWMON is not set
CONFIG_THERMAL=y
CONFIG_THERMAL_WRITABLE_TRIPS=y
CONFIG_CPU_THERMAL=y
CONFIG_WATCHDOG=y
CONFIG_WATCHDOG_CORE=y
CONFIG_WATCHDOG_NOWAYOUT=y
# CONFIG_RC_CORE is not set
CONFIG_FB=y
# CONFIG_HID_GENERIC is not set
# CONFIG_USB_SUPPORT is not set
# CONFIG_IOMMU_SUPPORT is not set
CONFIG_EXT2_FS=y
CONFIG_EXT2_FS_XATTR=y
CONFIG_EXT2_FS_POSIX_ACL=y
CONFIG_EXT2_FS_SECURITY=y
CONFIG_EXT4_FS=y
CONFIG_EXT4_FS_POSIX_ACL=y
CONFIG_EXT4_FS_SECURITY=y
CONFIG_MSDOS_FS=y
CONFIG_VFAT_FS=y
CONFIG_NTFS_FS=y
CONFIG_NTFS_RW=y
CONFIG_PROC_CHILDREN=y
CONFIG_TMPFS=y
CONFIG_TMPFS_POSIX_ACL=y
CONFIG_CONFIGFS_FS=y
CONFIG_CRAMFS=y
CONFIG_ROMFS_FS=y
CONFIG_NLS_CODEPAGE_437=y
CONFIG_NLS_ASCII=y
CONFIG_NLS_ISO8859_1=y
CONFIG_NLS_UTF8=y
CONFIG_PRINTK_TIME=y
CONFIG_DYNAMIC_DEBUG=y
CONFIG_DEBUG_INFO=y
CONFIG_PAGE_OWNER=y
CONFIG_MAGIC_SYSRQ=y
CONFIG_DEBUG_PAGEALLOC=y
CONFIG_DEBUG_PAGEALLOC_ENABLE_DEFAULT=y
CONFIG_DEBUG_PAGE_REF=y
CONFIG_SLUB_DEBUG_ON=y
CONFIG_DEBUG_KMEMLEAK=y
CONFIG_DEBUG_STACK_USAGE=y
CONFIG_DEBUG_MEMORY_INIT=y
CONFIG_SOFTLOCKUP_DETECTOR=y
CONFIG_DEFAULT_HUNG_TASK_TIMEOUT=30
CONFIG_PANIC_TIMEOUT=5
CONFIG_PROVE_LOCKING=y
CONFIG_LOCK_STAT=y
CONFIG_DEBUG_LOCKDEP=y
CONFIG_DEBUG_ATOMIC_SLEEP=y
CONFIG_CPU_HOTPLUG_STATE_CONTROL=y
CONFIG_LATENCYTOP=y
CONFIG_IRQSOFF_TRACER=y
CONFIG_PREEMPT_TRACER=y
CONFIG_SCHED_TRACER=y
CONFIG_FTRACE_SYSCALLS=y
CONFIG_STACK_TRACER=y
CONFIG_BLK_DEV_IO_TRACE=y
CONFIG_FUNCTION_PROFILER=y
CONFIG_DEBUG_USER=y
CONFIG_KEYS=y
CONFIG_SECURITYFS=y
CONFIG_CRYPTO_RSA=m
CONFIG_CRYPTO_DH=m
CONFIG_CRYPTO_ECDH=m
CONFIG_CRYPTO_USER=m
CONFIG_CRYPTO_TEST=m
CONFIG_CRYPTO_LRW=m
CONFIG_CRYPTO_XTS=m
CONFIG_CRYPTO_MD5=m
CONFIG_CRYPTO_SHA512=m
CONFIG_CRYPTO_SHA3=m
CONFIG_CRYPTO_SALSA20=m
CONFIG_CRYPTO_LZO=m
CONFIG_CRYPTO_LZ4=m
CONFIG_CRYPTO_USER_API_HASH=m
CONFIG_CRYPTO_USER_API_SKCIPHER=m
CONFIG_CRYPTO_USER_API_RNG=m
CONFIG_CRYPTO_USER_API_AEAD=m
CONFIG_ARM_CRYPTO=y
CONFIG_CRYPTO_SHA1_ARM_NEON=m
CONFIG_CRYPTO_SHA256_ARM=m
CONFIG_CRYPTO_SHA512_ARM=m
CONFIG_CRYPTO_AES_ARM_BS=m
CONFIG_CRYPTO_CHACHA20_NEON=m
CONFIG_CRC_CCITT=y
CONFIG_LIBCRC32C=m
```
