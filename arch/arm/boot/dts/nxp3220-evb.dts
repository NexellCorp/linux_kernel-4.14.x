// SPDX-License-Identifier: (GPL-2.0+ OR MIT)
/*
 * Copyright (C) 2018  Nexell Co., Ltd.
 * Author: JungHyun, Kim <jhkim@nexell.co.kr>
 */

/dts-v1/;

#include "nxp3220-evb-common.dtsi"

#define PMIC_PDATA_INIT(_id, _rname, _minuv,		\
                        _maxuv, _init_uv, _init_enable,	\
                        _set_init_uV, _slp_slots)	\
                regulator-name = _rname;                \
                regulator-min-microvolt = <_minuv>;     \
                regulator-max-microvolt = <_maxuv>;     \
                nx,id = <_id>;                          \
                nx,init_enable = <_init_enable>;        \
                nx,init_uV = <_init_uv>;                \
                nx,set_init_uV = <_set_init_uV>;        \
                nx,sleep_slots = <_slp_slots>;

/ {
	compatible = "nexell,nxp3220-evb", "nexell,nxp3220";
};
