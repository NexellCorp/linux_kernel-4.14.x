// SPDX-License-Identifier: (GPL-2.0+ OR MIT)
/*
 * Copyright (C) 2018  Nexell Co., Ltd.
 * Author: JungHyun, Kim <jhkim@nexell.co.kr>
 */

/dts-v1/;

#include "nxp3220-evb2-common.dtsi"

/ {
	compatible = "nexell,nxp3220-evb2", "nexell,nxp3220";
};
