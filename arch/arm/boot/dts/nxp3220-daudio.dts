// SPDX-License-Identifier: (GPL-2.0+ OR MIT)
/*
 * Copyright (C) 2018  Nexell Co., Ltd.
 * Author: JungHyun, Kim <jhkim@nexell.co.kr>
 */

/dts-v1/;

#include "nxp3220-evb-common.dtsi"

/ {
	compatible = "nexell,nxp3220-daudio", "nexell,nxp3220";
};

&dwmmc_0 {
	mmc-ddr-3_3v;
	status = "okay";
};

&dwmmc_2 {
	deferred-probe;
	status = "okay";
};
